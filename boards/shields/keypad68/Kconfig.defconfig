## boards/shields/keypad68/Kconfig.defconfig
```kconfig
if SHIELD_KEYPAD68

# Name must be less than 16 characters long!
config ZMK_KEYBOARD_NAME
    default "keypad68"

endif
```

## boards/shields/keypad68/Kconfig.shield
```kconfig
# No whitespace after the comma or in your keyboard name!
config SHIELD_KEYPAD68
    def_bool $(shields_list_contains,keypad68)
```
